## boards/shields/daxs/Kconfig.defconfig
```kconfig
if SHIELD_DAXS_R

config ZMK_KEYBOARD_NAME
  default "daxs_R"

config ZMK_SPLIT_ROLE_CENTRAL
  default y

endif

if SHIELD_DAXS_L

config ZMK_KEYBOARD_NAME
  default "daxs_L"

endif

if SHIELD_DAXS_R || SHIELD_DAXS_L

config ZMK_SPLIT
  default y

endif
```

## boards/shields/daxs/Kconfig.shield
```kconfig
config SHIELD_DAXS_R
  def_bool $(shields_list_contains,daxs_R)

config SHIELD_DAXS_L
  def_bool $(shields_list_contains,daxs_L)
```

## config/west.yml
```yaml
manifest:
  remotes:
    - name: zmkfirmware
      url-base: https://github.com/zmkfirmware
    - name: cormoran
      url-base: https://github.com/cormoran
    - name: caksoylar
      url-base: https://github.com/caksoylar
    - name: sekigon-gonnoc
      url-base: https://github.com/sekigon-gonnoc
    - name: wadackel
      url-base: https://github.com/wadackel
  projects:
    - name: zmk
      remote: cormoran
      revision: 1fc72aaff7a42bd533c1f4c9b3f23c5317c745f4  # main+custom-studio-protocol as of 2026-07-22 (ZMK main + custom Studio RPC)
      import: app/west.yml
    - name: zmk-behavior-runtime-sensor-rotate
      remote: cormoran
      revision: 8b1125ed676c1f5e14145d217984f33d0ebdcef4  # main as of 2026-07-06
    - name: zmk-driver-paw3222
      remote: sekigon-gonnoc
      revision: df652881be2520bde4f64ab6ca35e4c5708f4f9b  # main as of 2026-06-15, builds against ZMK main
    - name: zmk-rgbled-widget
      remote: caksoylar
      revision: e6b467792a1dabef8cfa5c9fd26bfefc9c16662b  # main as of 2026-07-09
    - name: zmk-dax-modules
      remote: wadackel
      revision: 816e363d8cf0b01ef9c9cf7ea2ffea4f49209f2c  # feat/dax-pointer as of 2026-10-20, until it merges
  self:
    path: config
```
